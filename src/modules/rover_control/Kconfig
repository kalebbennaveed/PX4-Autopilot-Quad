## src/modules/rover_control/Kconfig
```kconfig
menuconfig MODULES_ROVER_CONTROL
	bool "rover_control"
	default n
	---help---
		Enable support for rover_control

menuconfig USER_ROVER_CONTROL
	bool "rover_control running as userspace module"
	default y
	depends on BOARD_PROTECTED && MODULES_ROVER_CONTROL
	---help---
		Put rover_control in userspace memory
```
